#include "eyes.h"
#define TOUCH_PIN 7
#include <Arduino.h>
#include <Servo.h>

// bitmaps arrays here 
const unsigned char normalBitmap[] U8X8_PROGMEM={
    0x00, 0x00, 0x00, 0x00, 0x00, 0x00, 0x00, 0x00, 0x00, 0x00, 0x00, 0x00, 
  0x00, 0x00, 0x00, 0x00, 0x00, 0x00, 0x00, 0x00, 0x00, 0x00, 0x00, 0x00, 
  0x00, 0x00, 0x00, 0x00, 0x00, 0x00, 0x00, 0x00, 0x00, 0x00, 0x00, 0x00, 
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  0x00, 0x00, 0x00, 0x00,
};
const unsigned char blinkBitmap[] U8X8_PROGMEM={
    0x00, 0x00, 0x00, 0x00, 0x00, 0x00, 0x00, 0x00, 0x00, 0x00, 0x00, 0x00, 
  0x00, 0x00, 0x00, 0x00, 0x00, 0x00, 0x00, 0x00, 0x00, 0x00, 0x00, 0x00, 
  0x00, 0x00, 0x00, 0x00, 0x00, 0x00, 0x00, 0x00, 0x00, 0x00, 0x00, 0x00, 
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  0x00, 0x00, 0x00, 0x00,
};
const unsigned char lookRightBitmap[] U8X8_PROGMEM={
  0x00, 0x00, 0x00, 0x00, 0x00, 0x00, 0x00, 0x00, 0x00, 0x00, 0x00, 0x00, 
  0x00, 0x00, 0x00, 0x00, 0x00, 0x00, 0x00, 0x00, 0x00, 0x00, 0x00, 0x00, 
  0x00, 0x00, 0x00, 0x00, 0x00, 0x00, 0x00, 0x00, 0x00, 0x00, 0x00, 0x00, 
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  0x00, 0x00, 0x00, 0x00,
};
const unsigned char lookLeftBitmap[] U8X8_PROGMEM={
  0x00, 0x00, 0x00, 0x00, 0x00, 0x00, 0x00, 0x00, 0x00, 0x00, 0x00, 0x00, 
  0x00, 0x00, 0x00, 0x00, 0x00, 0x00, 0x00, 0x00, 0x00, 0x00, 0x00, 0x00, 
  0x00, 0x00, 0x00, 0x00, 0x00, 0x00, 0x00, 0x00, 0x00, 0x00, 0x00, 0x00, 
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  0x00, 0x00, 0x00, 0x00,
};
const unsigned char happyBitmap[] U8X8_PROGMEM={
  0x00, 0x00, 0x00, 0x00, 0x00, 0x00, 0x00, 0x00, 0x00, 0x00, 0x00, 0x00, 
  0x00, 0x00, 0x00, 0x00, 0x00, 0x00, 0x00, 0x00, 0x00, 0x00, 0x00, 0x00, 
  0x00, 0x00, 0x00, 0x00, 0x00, 0x00, 0x00, 0x00, 0x00, 0x00, 0x00, 0x00, 
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  0x00, 0x00, 0x00, 0x00,
};
const unsigned char sleepyBitmap[] U8X8_PROGMEM={
  0x00, 0x00, 0x00, 0x00, 0x00, 0x00, 0x00, 0x00, 0x00, 0x00, 0x00, 0x00, 
  0x00, 0x00, 0x00, 0x00, 0x00, 0x00, 0x00, 0x00, 0x00, 0x00, 0x00, 0x00, 
  0x00, 0x00, 0x00, 0x00, 0x00, 0x00, 0x00, 0x00, 0x00, 0x00, 0x00, 0x00, 
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  0x00, 0x00, 0x00, 0x00,
};
const unsigned char sadBitmap[] U8X8_PROGMEM={
  0x00, 0x00, 0x00, 0x00, 0x00, 0x00, 0x00, 0x00, 0x00, 0x00, 0x00, 0x00, 
  0x00, 0x00, 0x00, 0x00, 0x00, 0x00, 0x00, 0x00, 0x00, 0x00, 0x00, 0x00, 
  0x00, 0x00, 0x00, 0x00, 0x00, 0x00, 0x00, 0x00, 0x00, 0x00, 0x00, 0x00, 
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  0x00, 0x00, 0x00, 0x00,
};
const unsigned char angryBitmap[] U8X8_PROGMEM = {
  0x00, 0x00, 0x00, 0x00, 0x00, 0x00, 0x00, 0x00, 0x00, 0x00, 0x00, 0x00, 
  0x00, 0x00, 0x00, 0x00, 0x00, 0x00, 0x00, 0x00, 0x00, 0x00, 0x00, 0x00, 
  0x00, 0x00, 0x00, 0x00, 0x00, 0x00, 0x00, 0x00, 0x00, 0x00, 0x00, 0x00, 
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  0x00, 0x00, 0x00, 0x00,
  // ...1024 byte olana kadar devam etmeli!
};
const unsigned char scaredBitmap[] U8X8_PROGMEM={
  0x00, 0x00, 0x00, 0x00, 0x00, 0x00, 0x00, 0x00, 0x00, 0x00, 0x00, 0x00, 
  0x00, 0x00, 0x00, 0x00, 0x00, 0x00, 0x00, 0x00, 0x00, 0x00, 0x00, 0x00, 
  0x00, 0x00, 0x00, 0x00, 0x00, 0x00, 0x00, 0x00, 0x00, 0x00, 0x00, 0x00, 
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  0x00, 0x00, 0x00, 0x00,
};
const unsigned char suprisedBitmap[] U8X8_PROGMEM={
    0x00, 0x00, 0x00, 0x00, 0x00, 0x00, 0x00, 0x00, 0x00, 0x00, 0x00, 0x00, 
  0x00, 0x00, 0x00, 0x00, 0x00, 0x00, 0x00, 0x00, 0x00, 0x00, 0x00, 0x00, 
  0x00, 0x00, 0x00, 0x00, 0x00, 0x00, 0x00, 0x00, 0x00, 0x00, 0x00, 0x00, 
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  0x00, 0x00, 0x00, 0x00,
};

// ============================================================
// 1. CONSTRUCTOR
// Initializes pins, default states, timers and servo settings
// ============================================================
robotEyes::robotEyes(U8G2 &display, int ldrPin, int touchPin, int buzzerPin, int micPin, int servoPin) 
  : u8g2(display), ldrPin(ldrPin), touchPin(touchPin), buzzerPin(buzzerPin), micPin(micPin), servoPin(servoPin){
  
  currentState = STATE_NORMAL; 
  lastBlinkCheckTime = 0;
  blinkStartTime = 0;
  isAutoBlinking = false;
  
  isScaredOfDark = false;
  isSleepyFromDark = false;
  wasInLight = true;       
  timeEnteredDark = 0;     
  
  isAngryFromTouch = false;
  touchStartTime = 0;
  wasTouched = false;
  
  idleState = 0; 
  lastIdleChangeTime = 0;
  
  soundState = 0;                
  lastSoundTime = 0;

  currentStartleState = STARTLE_NONE;
  startleStepStartTime = 0;
  startleSoundStep = 0;
  lastStartleSoundTime = 0;

  // Initial servo position
  currentServoAngle = ANGLE_CENTER;
  lastServoMoveTime = 0;
}


// ============================================================
// BEGIN() — Hardware setup, welcome splash, mic calibration
// ============================================================
void robotEyes::begin() {
  // Configure I/O pins
  pinMode(ldrPin, INPUT); 
  pinMode(touchPin, INPUT); 
  pinMode(buzzerPin, OUTPUT); 
  pinMode(micPin, INPUT);
  digitalWrite(buzzerPin, LOW); 

  // Start servo centered
  neckServo.attach(servoPin);
  neckServo.write(ANGLE_CENTER);
  delay(100);
  
  // Startup splash screen
  u8g2.firstPage();
  do {
    u8g2.setFont(u8g2_font_6x10_tf);
    u8g2.drawStr(20, 18, "eezV2 deskbot");
    u8g2.drawStr(56, 36, "by ");
    u8g2.drawStr(2, 54, "Emirhan Ensar Zeyrek ");
  } while (u8g2.nextPage());

  delay(3000);

  // Microphone baseline calibration
  long total = 0;
  for(int i=0; i<20; i++) {
    total += analogRead(micPin);
    delay(10);
  }
  micBaseLevel = total / 20;
}


// ============================================================
// UPDATE() — Main behavior logic, sensors, states, motion, sound
// ============================================================
void robotEyes::update() {
  
  unsigned long currentTime = millis();

  // Serial control input (manual override states 0–8)
  if (Serial.available() > 0) {
    char incomingChar = Serial.read(); 
    if (incomingChar != '\n' && incomingChar != '\r') {
      if (isDigit(incomingChar)) {
        int newState = incomingChar - '0'; 
        if (newState >= 0 && newState <= 8) currentState = newState;
      }
    }
  }


  // ============================================================
  // MIC: Detect loud noises and trigger startle sequence
  // ============================================================
  int micValue = analogRead(micPin);
  int diff = abs(micValue - micBaseLevel);

  // Trigger startle only if fully idle
  if (diff > MIC_THRESHOLD && currentStartleState == STARTLE_NONE) {
    currentStartleState = STARTLE_SHOCK1;
    startleStepStartTime = currentTime;

    // Start startle audio pattern
    startleSoundStep = 1; 
    lastStartleSoundTime = currentTime;
    tone(buzzerPin, FREQ_DU); 
  }

  // Handle multi-step startle animation timing
  if (currentStartleState != STARTLE_NONE) {
    unsigned long timeInStep = currentTime - startleStepStartTime;

    switch (currentStartleState) {
      case STARTLE_SHOCK1: 
        if (timeInStep >= TIME_SHOCK1) {
          currentStartleState = STARTLE_BLINK;
          startleStepStartTime = currentTime;
        }
        break;

      case STARTLE_BLINK:
        if (timeInStep >= TIME_BLINK) {
          currentStartleState = STARTLE_SHOCK2;
          startleStepStartTime = currentTime;
        }
        break;

      case STARTLE_SHOCK2:
        if (timeInStep >= TIME_SHOCK2) {
          currentStartleState = STARTLE_LOOK_LEFT;
          startleStepStartTime = currentTime;
        }
        break;

      case STARTLE_LOOK_LEFT:
        if (timeInStep >= TIME_LOOK) {
          currentStartleState = STARTLE_LOOK_RIGHT;
          startleStepStartTime = currentTime;
        }
        break;

      case STARTLE_LOOK_RIGHT:
        if (timeInStep >= TIME_LOOK) {
          currentStartleState = STARTLE_NONE;
          micBaseLevel = (micBaseLevel * 0.9) + (micValue * 0.1); // Auto recalibration
        }
        break;
    }
  }


  // Complete the step-by-step startle sound pattern
  if (currentStartleState != STARTLE_NONE && startleSoundStep > 0) {
    unsigned long soundTime = currentTime - lastStartleSoundTime;

    switch (startleSoundStep) {
      case 1: if (soundTime >= TIME_DU) { noTone(buzzerPin); lastStartleSoundTime=currentTime; startleSoundStep=2; } break;
      case 2: if (soundTime >= TIME_PAUSE_S) { tone(buzzerPin, FREQ_DIT); lastStartleSoundTime=currentTime; startleSoundStep=3; } break;
      case 3: if (soundTime >= TIME_DIT) { noTone(buzzerPin); lastStartleSoundTime=currentTime; startleSoundStep=4; } break;
      case 4: if (soundTime >= TIME_PAUSE_S) { tone(buzzerPin, FREQ_DU); lastStartleSoundTime=currentTime; startleSoundStep=5; } break;
      case 5: if (soundTime >= TIME_DU) { noTone(buzzerPin); lastStartleSoundTime=currentTime; startleSoundStep=6; } break;
      case 6: if (soundTime >= TIME_PAUSE_S) { tone(buzzerPin, FREQ_DIT); lastStartleSoundTime=currentTime; startleSoundStep=7; } break;
      case 7: if (soundTime >= TIME_DIT) { noTone(buzzerPin); lastStartleSoundTime=currentTime; startleSoundStep=8; } break;
      case 8: if (soundTime >= TIME_PAUSE_L) { tone(buzzerPin, FREQ_DU); lastStartleSoundTime=currentTime; startleSoundStep=9; } break;
      case 9: if (soundTime >= TIME_DU) { noTone(buzzerPin); lastStartleSoundTime=currentTime; startleSoundStep=10; } break;

      // Final sequence burst
      case 10: if (soundTime >= TIME_PAUSE_S) { tone(buzzerPin, FREQ_DIT); lastStartleSoundTime=currentTime; startleSoundStep=11; } break;
      case 11: if (soundTime >= TIME_DIT) { noTone(buzzerPin); lastStartleSoundTime=currentTime; startleSoundStep=12; } break;
      case 12: if (soundTime >= TIME_PAUSE_S) { tone(buzzerPin, FREQ_DU); lastStartleSoundTime=currentTime; startleSoundStep=13; } break;
      case 13: if (soundTime >= TIME_DU) { noTone(buzzerPin); lastStartleSoundTime=currentTime; startleSoundStep=14; } break;
      case 14: if (soundTime >= TIME_PAUSE_S) { tone(buzzerPin, FREQ_DIT); lastStartleSoundTime=currentTime; startleSoundStep=15; } break;
      case 15: if (soundTime >= TIME_DIT) { noTone(buzzerPin); lastStartleSoundTime=currentTime; startleSoundStep=16; } break;

      case 16: startleSoundStep = 0; break; // End sequence
    }
  }


  // ============================================================
  // LDR: Darkness detection (scared → sleepy transition)
  // ============================================================
  int ldrValue = analogRead(ldrPin);

  if (ldrValue < DARKNESS_THRESHOLD) {
    if (wasInLight) {
      wasInLight = false; 
      timeEnteredDark = currentTime; 
      isScaredOfDark = true;
    }
    if (!wasInLight && (currentTime - timeEnteredDark >= DARK_SLEEP_TIME)) {
      isSleepyFromDark = true; 
      isScaredOfDark = false;
    }
  } else {
    wasInLight = true;
    isScaredOfDark = false;
    isSleepyFromDark = false;
  }


  // ============================================================
  // AUTO-BLINK System (disabled during startle)
  // ============================================================
  if (currentStartleState == STARTLE_NONE) {
    if (isAutoBlinking) {
      if (currentTime - blinkStartTime >= BLINK_DURATION)
        isAutoBlinking = false;
    } 
    else {
      if (currentTime - lastBlinkCheckTime >= BLINK_INTERVAL) {
        if (currentState != STATE_BLINK && currentState != STATE_SLEEPY) {
          isAutoBlinking = true;
          blinkStartTime = currentTime;
        }
        lastBlinkCheckTime = currentTime;
      }
    }
  }


  // ============================================================
  // TOUCH INPUT: Angry/Mad/Happy interaction + sound logic
  // ============================================================
  int touchState = digitalRead(touchPin);
  bool canPlayNormalSound = (touchState == LOW && currentStartleState == STARTLE_NONE);

  // Touch detection & anger progression
  if (touchState == HIGH) {
    if (!wasTouched) {
      wasTouched = true; 
      touchStartTime = currentTime; 
      isAngryFromTouch = false;
      soundState = 0;
    }
    if (!isAngryFromTouch && (currentTime - touchStartTime >= ANGRY_TOUCH_DURATION)) {
      isAngryFromTouch = true;
      soundState = 0;
    }
  } else {
    if (wasTouched) {
      wasTouched = false;
      isAngryFromTouch = false;
      soundState = 0;
    }
  }


  // ============================================================
  // SOUND OUTPUT (disabled while startle sound is active)
  // ============================================================
  if (startleSoundStep == 0) {

    // Angry sound pattern
    if (touchState == HIGH) {
      if (isAngryFromTouch) {
        int freq = 1000; 
        switch (soundState) {
          case 0: if (currentTime - lastSoundTime >= ANGRY_SOUND_INTERVAL) { tone(buzzerPin, freq); lastSoundTime=currentTime; soundState=1;} break;
          case 1: if (currentTime - lastSoundTime >= ANGRY_SOUND_BEEP_DURATION) { noTone(buzzerPin); lastSoundTime=currentTime; soundState=2;} break;
          case 2: if (currentTime - lastSoundTime >= ANGRY_SOUND_PAUSE_DURATION) { tone(buzzerPin, freq); lastSoundTime=currentTime; soundState=3;} break;
          case 3: if (currentTime - lastSoundTime >= ANGRY_SOUND_BEEP_DURATION) { noTone(buzzerPin); lastSoundTime=currentTime; soundState=4;} break;
          case 4: if (currentTime - lastSoundTime >= ANGRY_SOUND_PAUSE_DURATION) { tone(buzzerPin, freq); lastSoundTime=currentTime; soundState=5;} break;
          case 5: if (currentTime - lastSoundTime >= ANGRY_SOUND_BEEP_DURATION) { noTone(buzzerPin); lastSoundTime=currentTime; soundState=0;} break;
        }
      }

      // Happy sound pattern
      else {
        int freq1 = 500; 
        int freq2 = 350;
        switch (soundState) {
          case 0: if (currentTime - lastSoundTime >= HAPPY_SOUND_INTERVAL) { tone(buzzerPin, freq1); lastSoundTime=currentTime; soundState=1;} break;
          case 1: if (currentTime - lastSoundTime >= HAPPY_SOUND_BEEP_DURATION) { noTone(buzzerPin); lastSoundTime=currentTime; soundState=2;} break;
          case 2: if (currentTime - lastSoundTime >= HAPPY_SOUND_PAUSE_DURATION) { tone(buzzerPin, freq2); lastSoundTime=currentTime; soundState=3;} break;
          case 3: if (currentTime - lastSoundTime >= HAPPY_SOUND_BEEP_DURATION) { noTone(buzzerPin); lastSoundTime=currentTime; soundState=4;} break;
          case 4: if (currentTime - lastSoundTime >= HAPPY_SOUND_PAUSE_DURATION) { tone(buzzerPin, freq1); lastSoundTime=currentTime; soundState=5;} break;
          case 5: if (currentTime - lastSoundTime >= HAPPY_SOUND_BEEP_DURATION) { noTone(buzzerPin); lastSoundTime=currentTime; soundState=0;} break;
        }
      }
    }

    // Normal idle sound (only if touch not active)
    else if (canPlayNormalSound) {
      if (soundState > 3) { soundState = 0; noTone(buzzerPin); }
      int freq1 = 400; 
      int freq2 = 250;

      switch (soundState) {
        case 0: if (currentTime - lastSoundTime >= SOUND_INTERVAL) { tone(buzzerPin, freq1); lastSoundTime=currentTime; soundState=1;} break;
        case 1: if (currentTime - lastSoundTime >= SOUND_BEEP_DURATION) { noTone(buzzerPin); lastSoundTime=currentTime; soundState=2;} break;
        case 2: if (currentTime - lastSoundTime >= SOUND_PAUSE_DURATION) { tone(buzzerPin, freq2); lastSoundTime=currentTime; soundState=3;} break;
        case 3: if (currentTime - lastSoundTime >= SOUND_BEEP_DURATION) { noTone(buzzerPin); lastSoundTime=currentTime; soundState=0;} break;
      }
    }
  }


  // ============================================================
  // RANDOM IDLE LOOKING (disabled during startle)
  // ============================================================
  if (currentStartleState == STARTLE_NONE && currentTime - lastIdleChangeTime >= IDLE_LOOK_INTERVAL) {
    lastIdleChangeTime = currentTime;
    idleState = random(0, 3); 
  }


  // ============================================================
  // SERVO CONTROL (head turning)
  // ============================================================
  int targetAngle = ANGLE_CENTER;

  // Angry head shaking (quick left/center motion)
  if (isAngryFromTouch) {
    if ((currentTime / 200) % 2 == 0) targetAngle = 30;
    else targetAngle = 0;
  }

  // Startle-specific head poses
  else if (currentStartleState != STARTLE_NONE) {
    switch (currentStartleState) {
      case STARTLE_SHOCK1:
      case STARTLE_BLINK:
      case STARTLE_SHOCK2: targetAngle = ANGLE_CENTER; break;
      case STARTLE_LOOK_LEFT:  targetAngle = ANGLE_LEFT; break;
      case STARTLE_LOOK_RIGHT: targetAngle = ANGLE_RIGHT; break;
    }
  }

  // Normal idle looking
  else if (currentState == STATE_NORMAL && !isScaredOfDark && !isSleepyFromDark) {
    switch (idleState) {
      case 0: targetAngle = ANGLE_CENTER; break;
      case 1: targetAngle = ANGLE_LEFT;   break;
      case 2: targetAngle = ANGLE_RIGHT;  break;
    }
  }
  
  // Default fallback
  else {
    targetAngle = ANGLE_CENTER;
  }

  // Update servo angle only when changed
  if (currentServoAngle != targetAngle) {
    neckServo.write(targetAngle);
    currentServoAngle = targetAngle;
  }
}


// ============================================================
// DRAW() — Rendering logic with strict priority system
// ============================================================
void robotEyes::draw() {
  
  // Touch has priority over normal animations
  int touchState = digitalRead(touchPin);
  if (touchState == HIGH) {
    if (isAngryFromTouch) angry();
    else happy();
    return;
  }
  
  // Startle animation overrides everything else
  if (currentStartleState != STARTLE_NONE) {
    switch (currentStartleState) {
      case STARTLE_SHOCK1:      suprised(); break;
      case STARTLE_BLINK:       blink();    break;
      case STARTLE_SHOCK2:      suprised(); break;
      case STARTLE_LOOK_LEFT:   lookLeft(); break;
      case STARTLE_LOOK_RIGHT:  lookRight(); break;
    }
    return;
  }

  // Auto-blink (secondary priority)
  if (isAutoBlinking) { blink(); return; }

  // Sleepy from darkness
  if (isSleepyFromDark) { sleepy(); return; }

  // Scared from darkness
  if (isScaredOfDark) { scared(); return; }

  // Normal behavior
  switch (currentState) {
    case STATE_NORMAL:
      switch (idleState) {
        case 0: normal(); break;
        case 1: lookLeft(); break;
        case 2: lookRight(); break;
      }
      break;

    case STATE_BLINK:       blink();     break;
    case STATE_LOOK_RIGHT:  lookRight(); break;
    case STATE_LOOK_LEFT:   lookLeft();  break;
    case STATE_HAPPY:       happy();     break;
    case STATE_SLEEPY:      sleepy();    break;
    case STATE_SAD:         sad();       break;
    case STATE_ANGRY:       angry();     break;
    case STATE_SCARED:      scared();    break;
  }
}


// ============================================================
// BITMAP DRAW FUNCTIONS — Just draw matching XBMP assets
// ============================================================
void robotEyes::normal(){       u8g2.drawXBMP(0, 0, 128, 64, normalBitmap); }
void robotEyes::blink(){        u8g2.drawXBMP(0, 0, 128, 64, blinkBitmap); }
void robotEyes::lookRight(){    u8g2.drawXBMP(0, 0, 128, 64, lookRightBitmap); }
void robotEyes::lookLeft(){     u8g2.drawXBMP(0, 0, 128, 64, lookLeftBitmap); }
void robotEyes::happy(){        u8g2.drawXBMP(0, 0, 128, 64, happyBitmap); }
void robotEyes::sleepy(){       u8g2.drawXBMP(0, 0, 128, 64, sleepyBitmap); }
void robotEyes::angry(){        u8g2.drawXBMP(0, 0, 128, 64, angryBitmap); }
void robotEyes::sad(){          u8g2.drawXBMP(0, 0, 128, 64, sadBitmap); }
void robotEyes::scared(){       u8g2.drawXBMP(0, 0, 128, 64, scaredBitmap); }
void robotEyes::suprised(){     u8g2.drawXBMP(0, 0, 128, 64, suprisedBitmap); }
